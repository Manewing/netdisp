## main/Kconfig.projbuild
```kconfig
menu "Network Display Configuration"
    config NETDISP_WIFI_SSID
        string "WiFi SSID"
        default "SSID"
        help
            SSID (network name) for the example to connect to.

    config NETDISP_WIFI_PASSWORD
        string "WiFi Password"
        default "Password"
        help
            WiFi password (WPA or WPA2) for the example to use.

    config NETDISP_WIFI_MAX_RETRY
        int "Maximum retry"
        default 10
        help
            Set the Maximum retry to avoid station reconnecting to the AP unlimited when the AP is really inexistent.
    config NETDISP_PORT
        int "Port"
        default 5432
        help
            The port the network display is supposed to listen to.
    config NETDISP_MAX_MSG_LEN
        int "Maximum Message Length"
        default 2048
        help
            Maximum length of message to be received.
    config NETDISP_LED_0_PIN
        int "LED 0 GPIO Pin"
        range 0 33
        default 17
        help
            GPIO pin of LED 0, will be set to high to turn on LED.
    config NETDISP_LED_1_PIN
        int "LED 1 GPIO Pin"
        range 0 33
        default 16
        help
            GPIO pin of LED 1, will be set to high to turn on LED.
    config NETDISP_ROTENC_PIN_A
        int "Rotary Encoder Pin A"
        range 0 33
        default 19
        help
            GPIO pin for rotary encoder Signal A.
    config NETDISP_ROTENC_PIN_B
        int "Rotary Encoder Pin B"
        range 0 33
        default 18
        help
            GPIO pin for rotary encoder Signal B.
     config NETDISP_VIEW_COUNT
        int "Netdisp View Count"
        range 1 100
        default 10
        help
            Number of individual views for the netdisp
      config NETDISP_VIEW_TIMEOUT_MS
        int "View Timeout ms"
        default 60000
        help
            Timeout in ms after which view is deleted
      config NETDISP_NOTIFICATION_MAX_TIMEOUT_MS
        int "Max Notification Timeout ms"
        default 5000
        help
            Maximum allowed timeout in ms after which notification is deleted
endmenu
```
